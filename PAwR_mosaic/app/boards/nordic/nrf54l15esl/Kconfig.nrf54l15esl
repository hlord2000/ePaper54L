## PAwR_mosaic/app/boards/nordic/nrf54l15esl/Kconfig.nrf54l15esl
```kconfig
# Copyright (c) 2024 Nordic Semiconductor ASA
# SPDX-License-Identifier: Apache-2.0

config BOARD_NRF54L15ESL
	select SOC_NRF54L15_ENGA_CPUAPP if BOARD_NRF54L15ESL_NRF54L15_ENGA_CPUAPP || BOARD_NRF54L15ESL_NRF54L15_ENGA_CPUAPP_NS
	select SOC_NRF54L15_ENGA_CPUFLPR if BOARD_NRF54L15ESL_NRF54L15_ENGA_CPUFLPR || \
					    BOARD_NRF54L15ESL_NRF54L15_ENGA_CPUFLPR_XIP
```

## PAwR_mosaic/app/boards/nordic/nrf54l15esl_rev_a/board.yml
```yaml
board:
  name: nrf54l15esl_rev_a
  vendor: nordic
  socs:
  - name: nrf54l15
    variants:
    - name: xip
      cpucluster: cpuflpr
    - name: ns
      cpucluster: cpuapp
```

## PAwR_mosaic/app/build/Kconfig/arch/Kconfig
```kconfig
# Load Zephyr Arch Kconfig descriptions.
osource "/opt/ncs/ncs-v2.8/zephyr/arch/x86/Kconfig"
osource "/opt/ncs/ncs-v2.8/zephyr/arch/xtensa/Kconfig"
osource "/opt/ncs/ncs-v2.8/zephyr/arch/sparc/Kconfig"
osource "/opt/ncs/ncs-v2.8/zephyr/arch/riscv/Kconfig"
osource "/opt/ncs/ncs-v2.8/zephyr/arch/posix/Kconfig"
osource "/opt/ncs/ncs-v2.8/zephyr/arch/nios2/Kconfig"
osource "/opt/ncs/ncs-v2.8/zephyr/arch/mips/Kconfig"
osource "/opt/ncs/ncs-v2.8/zephyr/arch/arm64/Kconfig"
osource "/opt/ncs/ncs-v2.8/zephyr/arch/arm/Kconfig"
osource "/opt/ncs/ncs-v2.8/zephyr/arch/arc/Kconfig"
```

## PAwR_mosaic/app/build/app/Kconfig/Kconfig.shield
```kconfig
osource "/home/hlord/Documents/Nordic/ePaper54L/PAwR_mosaic/app/boards/shields/*/Kconfig.shield"
osource "/opt/ncs/ncs-v2.8/nrf/boards/shields/*/Kconfig.shield"
```

## PAwR_mosaic/app/build/app/Kconfig/Kconfig.shield.defconfig
```kconfig
osource "/home/hlord/Documents/Nordic/ePaper54L/PAwR_mosaic/app/boards/shields/*/Kconfig.defconfig"
osource "/opt/ncs/ncs-v2.8/nrf/boards/shields/*/Kconfig.defconfig"
```

## PAwR_mosaic/app/build/app/Kconfig/boards/Kconfig.sysbuild
```kconfig
# Load Sysbuild board Kconfig descriptions.
osource "/home/hlord/Documents/Nordic/ePaper54L/PAwR_mosaic/app/boards/nordic/nrf54l15esl/Kconfig.sysbuild"
```

## app/boards/hlord2000/nrf54l15esl_rev_a/board.yml
```yaml
board:
  name: nrf54l15esl_rev_a
  vendor: helmut 
  socs:
  - name: nrf54l15
    variants:
    - name: xip
      cpucluster: cpuflpr
    - name: ns
      cpucluster: cpuapp
```

## firmware/esl_peripheral_sync/boards/hlord2000/nrf54l15esl/board.yml
```yaml
board:
  name: nrf54l15esl
  vendor: helmut 
  socs:
  - name: nrf54l15
    variants:
    - name: xip
      cpucluster: cpuflpr
    - name: ns
      cpucluster: cpuapp
```

## firmware/esl_peripheral_sync/boards/hlord2000/nrf54l15esl_rev_a/Kconfig.nrf54l15esl_rev_a
```kconfig
# Copyright (c) 2024 Nordic Semiconductor ASA
# SPDX-License-Identifier: Apache-2.0

config BOARD_NRF54L15ESL_REV_A
	select SOC_NRF54L15_ENGA_CPUAPP if BOARD_NRF54L15ESL_REV_A_NRF54L15_CPUAPP || BOARD_NRF54L15ESL_REV_A_NRF54L15_CPUAPP_NS
	select SOC_NRF54L15_ENGA_CPUFLPR if BOARD_NRF54L15ESL_REV_A_NRF54L15_CPUFLPR || \
					    BOARD_NRF54L15ESL_REV_A_NRF54L15_CPUFLPR_XIP
```

## firmware/esl_peripheral_sync/boards/hlord2000/nrf54l15esl_rev_a/nrf54l15esl_rev_a_nrf54l15_cpuapp_defconfig
```kconfig
# Copyright (c) 2024 Nordic Semiconductor ASA
# SPDX-License-Identifier: Apache-2.0

# Enable UART driver
CONFIG_SERIAL=y

# Enable console
CONFIG_CONSOLE=y
CONFIG_UART_CONSOLE=y

# Enable GPIO
CONFIG_GPIO=y

# Enable MPU
CONFIG_ARM_MPU=y

# Enable hardware stack protection
CONFIG_HW_STACK_PROTECTION=y

# MPU-based null-pointer dereferencing detection cannot
# be applied as the (0x0 - 0x400) is unmapped for this target.
CONFIG_NULL_POINTER_EXCEPTION_DETECTION_NONE=y

# Enable Cache
CONFIG_CACHE_MANAGEMENT=y
CONFIG_EXTERNAL_CACHE=y

CONFIG_SOC_NRF_FORCE_CONSTLAT=y

# Start SYSCOUNTER on driver init
CONFIG_NRF_GRTC_START_SYSCOUNTER=y

# Enable EPD
CONFIG_SPI=y

CONFIG_HEAP_MEM_POOL_SIZE=16384

CONFIG_PAWR_EPD=y
CONFIG_LV_Z_VDB_SIZE=16
CONFIG_LV_DPI_DEF=130
CONFIG_LV_Z_BITS_PER_PIXEL=1
CONFIG_LV_Z_MEM_POOL_SIZE=16384
CONFIG_LV_COLOR_DEPTH_1=y

# Rev. A specific command
CONFIG_UART_NRFX_UARTE_LEGACY_SHIM=n

# Enable SHT40
CONFIG_SENSOR=y
CONFIG_SENSOR_SHELL=y
```
